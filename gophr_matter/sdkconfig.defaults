## gophr_matter/sdkconfig.defaults
```kconfig
#
# Gophr Matter-over-Thread Sensor - sdkconfig defaults
#

# Partition table
CONFIG_PARTITION_TABLE_CUSTOM=y
CONFIG_PARTITION_TABLE_CUSTOM_FILENAME="partitions.csv"
CONFIG_PARTITION_TABLE_OFFSET=0x8000

# Flash size
CONFIG_ESPTOOLPY_FLASHSIZE_4MB=y

# BLE (required for Matter commissioning)
CONFIG_BT_ENABLED=y
CONFIG_BT_NIMBLE_ENABLED=y

# lwIP
CONFIG_LWIP_IPV6_NUM_ADDRESSES=8
CONFIG_LWIP_MULTICAST_PING=y

# Matter
CONFIG_CHIP_DEVICE_VENDOR_ID=0xFFF1
CONFIG_CHIP_DEVICE_PRODUCT_ID=0x8006
CONFIG_ENABLE_CHIP_SHELL=n

# OpenThread (Thread networking)
CONFIG_OPENTHREAD_ENABLED=y
CONFIG_OPENTHREAD_MTD=y
CONFIG_OPENTHREAD_SRP_CLIENT=y
CONFIG_OPENTHREAD_DNS_CLIENT=y
CONFIG_OPENTHREAD_LOG_LEVEL_DYNAMIC=n
CONFIG_OPENTHREAD_LOG_LEVEL_NOTE=y

# Disable Wi-Fi (Thread-only device)
CONFIG_ENABLE_WIFI_STATION=n
CONFIG_ENABLE_WIFI_AP=n
CONFIG_USE_MINIMAL_MDNS=n

# mbedTLS
CONFIG_MBEDTLS_CMAC_C=y
CONFIG_MBEDTLS_SSL_PROTO_DTLS=y
CONFIG_MBEDTLS_KEY_EXCHANGE_ECJPAKE=y

# I2C legacy conflict check (needed for newer ESP-IDF)
CONFIG_I2C_SKIP_LEGACY_CONFLICT_CHECK=y

# Stack sizes
CONFIG_ESP_MAIN_TASK_STACK_SIZE=8192
```

## gophr_sim/main/Kconfig.projbuild
```kconfig
menu "Gophr Simulator Configuration"

    config GOPHR_WIFI_SSID
        string "WiFi SSID"
        default "your_ssid"
        help
            SSID of the WiFi network to connect to.

    config GOPHR_WIFI_PASSWORD
        string "WiFi Password"
        default "your_password"
        help
            Password for the WiFi network.

    config GOPHR_MQTT_BROKER_URI
        string "MQTT Broker URI"
        default "mqtt://homeassistant.local:1883"
        help
            URI of the MQTT broker (e.g. mqtt://192.168.1.100:1883).

    config GOPHR_MQTT_USERNAME
        string "MQTT Username"
        default ""
        help
            MQTT broker username. Leave empty if not required.

    config GOPHR_MQTT_PASSWORD
        string "MQTT Password"
        default ""
        help
            MQTT broker password. Leave empty if not required.

endmenu
```

## gophr_sim/sdkconfig.defaults
```kconfig
#
# Gophr Moisture Simulator - sdkconfig defaults
# Target: ESP32-S3 (M5Dial)
#

# Partition table
CONFIG_PARTITION_TABLE_CUSTOM=y
CONFIG_PARTITION_TABLE_CUSTOM_FILENAME="partitions.csv"
CONFIG_PARTITION_TABLE_OFFSET=0x8000

# ESP32-S3 specific
CONFIG_ESP_DEFAULT_CPU_FREQ_240=y

# M5Dial (ESP32-S3FN8) has NO external PSRAM
# CONFIG_SPIRAM is not set

# Flash
CONFIG_ESPTOOLPY_FLASHSIZE_8MB=y
CONFIG_ESPTOOLPY_FLASHMODE_QIO=y
CONFIG_ESPTOOLPY_FLASHFREQ_80M=y

# LVGL fonts
CONFIG_LV_FONT_MONTSERRAT_12=y
CONFIG_LV_FONT_MONTSERRAT_14=y
CONFIG_LV_FONT_MONTSERRAT_20=y
CONFIG_LV_FONT_MONTSERRAT_32=y
CONFIG_LV_FONT_MONTSERRAT_48=y

# FreeRTOS
CONFIG_FREERTOS_HZ=1000
```

## gophr_zigbee/sdkconfig.defaults
```kconfig
#
# Gophr Zigbee Sensor - sdkconfig defaults
#

# Partition table
CONFIG_PARTITION_TABLE_CUSTOM=y
CONFIG_PARTITION_TABLE_CUSTOM_FILENAME="partitions.csv"
CONFIG_PARTITION_TABLE_OFFSET=0x8000
CONFIG_PARTITION_TABLE_MD5=y

# mbedTLS - required for Zigbee security
CONFIG_MBEDTLS_HARDWARE_AES=n
CONFIG_MBEDTLS_HARDWARE_MPI=n
CONFIG_MBEDTLS_HARDWARE_SHA=n
CONFIG_MBEDTLS_CMAC_C=y
CONFIG_MBEDTLS_SSL_PROTO_DTLS=y
CONFIG_MBEDTLS_KEY_EXCHANGE_ECJPAKE=y

# Zigbee
CONFIG_ZB_ENABLED=y
CONFIG_ZB_ZED=y
```
